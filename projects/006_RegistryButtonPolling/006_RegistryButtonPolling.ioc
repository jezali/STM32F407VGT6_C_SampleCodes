# file: 006_RegistryButtonPolling.ioc
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Mcu.Family=STM32F4
Mcu.Name=STM32F407V(E-G)Tx
Mcu.Package=LQFP100
NVIC.PriorityGroup=NVIC_PRIORITYGROUP_4
ProjectManager.HeapSize=0x200
ProjectManager.StackSize=0x400
ProjectManager.TargetToolchain=EWARM V8.50
RCC.48MHZClocksFreq_Value=84000000
RCC.AHBFreq_Value=168000000
RCC.APB1CLKDivider=RCC_HCLK_DIV4
RCC.APB1Freq_Value=42000000
RCC.APB1TimFreq_Value=84000000
RCC.APB2CLKDivider=RCC_HCLK_DIV2
RCC.APB2Freq_Value=84000000
RCC.APB2TimFreq_Value=168000000
RCC.CortexFreq_Value=168000000
RCC.HCLKFreq_Value=168000000
RCC.HSE_VALUE=25000000
RCC.HSI_VALUE=16000000
RCC.LSE_VALUE=32768
RCC.PLLM=8
RCC.PLLN=168
RCC.SYSCLKFreq_VALUE=168000000
RCC.SYSCLKSource=RCC_SYSCLKSOURCE_PLLCLK
RCC.VCOOutputFreq_Value=336000000
board=custom

// file: Core/Src/main.c
/* USER CODE BEGIN Header */
/**
  ******************************************************************************
  * @file           : main.c
  * @brief          : Main program body
  ******************************************************************************
  * @attention
  *
  * Copyright (c) 2026 STMicroelectronics.
  * All rights reserved.
  *
  * This software is licensed under terms that can be found in the LICENSE file
  * in the root directory of this software component.
  * If no LICENSE file comes with this software, it is provided AS-IS.
  *
  ******************************************************************************
  */
/* USER CODE END Header */
#include "main.h"

/* USER CODE BEGIN PD */

#define LED0_GPIO_Port			GPIOC
#define LED0_Pin			13

#define BTN0_GPIO_Port			GPIOE
#define BTN0_Pin			4

#define LED1_GPIO_Port			GPIOC
#define LED1_Pin			14

#define BTN1_GPIO_Port			GPIOE
#define BTN1_Pin			5

#define LED2_GPIO_Port			GPIOC
#define LED2_Pin			15

#define BTN2_GPIO_Port			GPIOE
#define BTN2_Pin			6

/* USER CODE END PD */

void SystemClock_Config(void);
/* USER CODE BEGIN PFP */
void led_init(GPIO_TypeDef* gpio, uint16_t pin);
void led_togle(GPIO_TypeDef* gpio, uint16_t pin);

void btn_init(GPIO_TypeDef* gpio, uint16_t pin);
uint8_t btn_read(GPIO_TypeDef* gpio, uint16_t pin);
/* USER CODE END PFP */

int main(void)
{

  /* MCU Configuration--------------------------------------------------------*/

  /* Reset of all peripherals, Initializes the Flash interface and the Systick. */
  HAL_Init();

  /* Configure the system clock */
  SystemClock_Config();

  /* Initialize all configured peripherals */
  /* USER CODE BEGIN 2 */
  RCC->AHB1ENR |= RCC_AHB1ENR_GPIOCEN;
  RCC->AHB1ENR |= RCC_AHB1ENR_GPIOEEN;

  led_init(LED0_GPIO_Port, LED0_Pin);
  btn_init(BTN0_GPIO_Port, BTN0_Pin);

  led_init(LED1_GPIO_Port, LED1_Pin);
  btn_init(BTN1_GPIO_Port, BTN1_Pin);

  led_init(LED2_GPIO_Port, LED2_Pin);
  btn_init(BTN2_GPIO_Port, BTN2_Pin);
  /* USER CODE END 2 */

  /* Infinite loop */
  /* USER CODE BEGIN WHILE */
  while (1)
  {
    if (btn_read(BTN0_GPIO_Port, BTN0_Pin) == 0) {
      // Debaunce
      HAL_Delay(50);
      // Press
      led_togle(LED0_GPIO_Port, LED0_Pin);
      // Hold
      while (btn_read(BTN0_GPIO_Port, BTN0_Pin) == 0) {
      }
      // Release
      // Debaunce
      HAL_Delay(50);
    }
      if (btn_read(BTN1_GPIO_Port, BTN1_Pin) == 0) {
      // Debaunce
      HAL_Delay(50);
      // Press
      led_togle(LED1_GPIO_Port, LED1_Pin);
      // Hold
      while (btn_read(BTN1_GPIO_Port, BTN1_Pin) == 0) {
      }
      // Release
      // Debaunce
      HAL_Delay(50);
    }
      if (btn_read(BTN2_GPIO_Port, BTN2_Pin) == 0) {
      // Debaunce
      HAL_Delay(50);
      // Press
      led_togle(LED2_GPIO_Port, LED2_Pin);
      // Hold
      while (btn_read(BTN2_GPIO_Port, BTN2_Pin) == 0) {
      }
      // Release
      // Debaunce
      HAL_Delay(50);
    }
    /* USER CODE END WHILE */

  }
}

void SystemClock_Config(void)
{
  RCC_OscInitTypeDef RCC_OscInitStruct = {0};
  RCC_ClkInitTypeDef RCC_ClkInitStruct = {0};

  /** Configure the main internal regulator output voltage
  */
  __HAL_RCC_PWR_CLK_ENABLE();
  __HAL_PWR_VOLTAGESCALING_CONFIG(PWR_REGULATOR_VOLTAGE_SCALE1);

  /** Initializes the RCC Oscillators according to the specified parameters
  * in the RCC_OscInitTypeDef structure.
  */
  RCC_OscInitStruct.OscillatorType = RCC_OSCILLATORTYPE_HSI;
  RCC_OscInitStruct.HSIState = RCC_HSI_ON;
  RCC_OscInitStruct.HSICalibrationValue = RCC_HSICALIBRATION_DEFAULT;
  RCC_OscInitStruct.PLL.PLLState = RCC_PLL_ON;
  RCC_OscInitStruct.PLL.PLLSource = RCC_PLLSOURCE_HSI;
  RCC_OscInitStruct.PLL.PLLM = 8;
  RCC_OscInitStruct.PLL.PLLN = 168;
  RCC_OscInitStruct.PLL.PLLP = RCC_PLLP_DIV2;
  RCC_OscInitStruct.PLL.PLLQ = 4;
  if (HAL_RCC_OscConfig(&RCC_OscInitStruct) != HAL_OK)
  {
    Error_Handler();
  }

  /** Initializes the CPU, AHB and APB buses clocks
  */
  RCC_ClkInitStruct.ClockType = RCC_CLOCKTYPE_HCLK|RCC_CLOCKTYPE_SYSCLK
                              |RCC_CLOCKTYPE_PCLK1|RCC_CLOCKTYPE_PCLK2;
  RCC_ClkInitStruct.SYSCLKSource = RCC_SYSCLKSOURCE_PLLCLK;
  RCC_ClkInitStruct.AHBCLKDivider = RCC_SYSCLK_DIV1;
  RCC_ClkInitStruct.APB1CLKDivider = RCC_HCLK_DIV4;
  RCC_ClkInitStruct.APB2CLKDivider = RCC_HCLK_DIV2;

  if (HAL_RCC_ClockConfig(&RCC_ClkInitStruct, FLASH_LATENCY_5) != HAL_OK)
  {
    Error_Handler();
  }
}

/* USER CODE BEGIN 4 */
void led_init(GPIO_TypeDef* gpio, uint16_t pin) {

  // Mode: deinit set to default, input
  gpio->MODER &= ~(0x3U << (pin * 2));
  // Mode: output
  gpio->MODER |= 0x1U << (pin * 2);
  // output type: push-pull
  gpio->OTYPER &= ~(0x1U << pin);
  // output speed: very high
  gpio->OSPEEDR |= 0x3U << (pin * 2);
}
void led_togle(GPIO_TypeDef* gpio, uint16_t pin) {
  gpio->ODR ^= 1 << pin;
}

void btn_init(GPIO_TypeDef* gpio, uint16_t pin) {
  //Mode: Input
  gpio->MODER &= ~(0x3U << (pin * 2));
  //Pull up
  gpio->PUPDR &= ~(0x3U << (pin * 2));
  gpio->PUPDR |= 0x1U << (pin * 2);
}
uint8_t btn_read(GPIO_TypeDef* gpio, uint16_t pin) {
  return (gpio->IDR & (1 << pin)) != 0;
}
/* USER CODE END 4 */

void Error_Handler(void)
{
  __disable_irq();
  while (1)
  {
  }
}
